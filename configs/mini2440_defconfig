## configs/mini2440_defconfig
```kconfig
CONFIG_ARM=y
CONFIG_TARGET_MINI2440=y
CONFIG_SYS_PROMPT="MINI2440 # "

CONFIG_SUPPORT_SPL=y
CONFIG_SPL=y 
#CONFIG_SPL_NAND_SUPPORT
#CONFIG_SPL_NAND_LOAD

# CONFIG_CMD_SETEXPR is not set
```
